## drivers/net/wireless/realtek/rtl8821cu/Kconfig
```kconfig
config RTL8821CU
	tristate "Realtek RTL8811CU/RTL8821CU USB WiFi"
	depends on USB && CFG80211
	select WIRELESS_EXT
	select WEXT_PRIV
	help
	  Vendor driver for RTL8811CU/RTL8821CU USB 802.11ac adapters.
	  Supports cfg80211 and includes the chipset firmware.
	  Choose Y to embed the driver in the kernel, or M for 8821cu.ko.
```
